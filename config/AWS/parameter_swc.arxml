AUTOSAR XML (schema 00046)
package /SWC
  parameter sw component type Parameter_SWC
    provide port PP_ThresholdParam: provided-interface=I_ThresholdParam
    parameter data prototype SpeedThreshold: type=float32, sw-value-constraint={min-value=0.0, max-value=200.0}
