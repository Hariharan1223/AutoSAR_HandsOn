AUTOSAR XML (schema 00046)
package /Interfaces
  sender receiver interface I_SpeedData
    data VehicleSpeed: implementation-data-type=float32
  parameter interface I_ThresholdParam
    parameter data prototype SpeedThreshold: type=float32
  nv data interface I_NVMaxSpeed
    nv-datas:
      data NVMaxSpeed: implementation-data-type=float32
  client server interface I_DiagnosticRequest
    operation SendDiagnosticRequest: possible-error=[I_DiagnosticRequest/E_OK, I_DiagnosticRequest/E_NOT_OK]
      arg EventId: type=uint16, direction=IN
    error E_OK: error-code=0
    error E_NOT_OK: error-code=1
  client server interface I_DiagnosticResponse
    operation SendDiagnosticResponse: possible-error=[I_DiagnosticResponse/E_OK, I_DiagnosticResponse/E_NOT_OK]
      arg ResponseCode: type=uint8, direction=OUT
    error E_OK: error-code=0
    error E_NOT_OK: error-code=1
  sender receiver interface I_InjectionCutoff
    data InjectionCutoffCommand: implementation-data-type=boolean
