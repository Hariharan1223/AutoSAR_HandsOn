AUTOSAR XML (schema 00046)
package /ComplexDeviceDriverSWC
  component ComplexDeviceDriverSWC
    require port InjectionCutoffIn: required-interface=I_InjectionCutoff
    behavior ComplexDeviceDriverInternalBehavior
      runnable ProcessInjectionCutoff: possible-error=[E_OK, E_NOT_OK]
