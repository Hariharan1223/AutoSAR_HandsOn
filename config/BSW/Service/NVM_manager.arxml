AUTOSAR XML (schema 00046)
package /NVMManagerSWC
  component NVMManagerSWC
    require port NVMaxSpeedIn: required-interface=I_NVMaxSpeed
    behavior NVMManagerInternalBehavior
      runnable StoreMaximumSpeed: possible-error=[E_OK, E_NOT_OK]
