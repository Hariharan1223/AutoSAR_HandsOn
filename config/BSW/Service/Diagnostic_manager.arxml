AUTOSAR XML (schema 00046)
package /DiagnosticManagerSWC
  component DiagnosticManagerSWC
    require port DiagnosticEventIn: required-interface=I_DiagnosticEvent
    behavior DiagnosticManagerInternalBehavior
      runnable LogDiagnosticEvent: possible-error=[E_OK, E_NOT_OK]
