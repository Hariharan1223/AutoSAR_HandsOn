AUTOSAR XML (schema 00046)
package /GptConfig
  module config GptModuleConfiguration: definition=Gpt
    GptGeneral: GptDeviceEnable=true
    GptChannelConfig
      GptChannel: GptChannelId=0, GptPeriod=1000
