AUTOSAR XML (schema 00046)
package /MemoryConfig
  module config MemoryModuleConfiguration: definition=Memory
    MemoryGeneral: MemoryDeviceEnable=true, MemorySize=1024
