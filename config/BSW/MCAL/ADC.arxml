AUTOSAR XML (schema 00046)
package /AdcConfig
  module config AdcModuleConfiguration: definition=Adc
    AdcGeneral: AdcEnable=true
    AdcConfigSet
      AdcGroup: AdcChannel=5, AdcSamplingTime=7
