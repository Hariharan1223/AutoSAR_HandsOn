AUTOSAR XML (schema 00046)
package /DioConfig
  module config DioModuleConfiguration: definition=Dio
    DioGeneral: DioDeviceEnable=true
    DioChannelConfig
      DioChannel: DioChannelId=3, DioPortId=GPIOA
